/* spectrum_tapes.c - which tape, out of the ones built into the firmware.
 *
 * Generated by tools/embed_tapes.py into spectrum_tape_data.c, which is
 * gitignored. Nothing is distributed with this project.
 */
#include "nvs_flash.h"
#include "nvs.h"
#include "spectrum.h"

#ifdef RETRO_BOARD_ANDROID
/* On Android the tapes are the .tap files in the card's spectrum/ folder
 * (card_catalogue.h), read when one is put in; the snapshots beside them
 * are spectrum_snap.c's. */
#include "card_catalogue.h"

static const char *const tape_exts[] = {".tap", NULL};
static card_catalogue tapes = CARD_CATALOGUE("spectrum", tape_exts, "spectapename");

int spectrum_tape_count(void) { return card_count(&tapes); }

const char *spectrum_tape_name(int i) {
    if (i < 0 || i >= card_count(&tapes)) return "Spectrum BASIC";
    return card_name(&tapes, i);
}

int spectrum_tape_selected(void) { return card_selected(&tapes); }
void spectrum_tape_select(int i) { card_select(&tapes, i); }

const unsigned char *spectrum_tape_image(void) { return card_bytes(&tapes, 0); }

int spectrum_tape_size(void) {
    int size;
    card_bytes(&tapes, &size);
    return size;
}

#else

#ifdef HAVE_SPECTRUM_TAPES
extern const struct { const char *name; const unsigned char *tap; int size; }
    spectrum_tape_catalogue[];
extern const int spectrum_tape_count_n;
#else
static const struct { const char *name; const unsigned char *tap; int size; }
    spectrum_tape_catalogue[1];
static const int spectrum_tape_count_n = 0;
#endif

#define NVS_NAMESPACE "cyd"
#define NVS_KEY       "spectape"

static int sSelected = -2;

static void loadSelection(void) {
    nvs_handle_t h;
    int32_t v = -1;
    sSelected = -1;
    if (nvs_open(NVS_NAMESPACE, NVS_READONLY, &h) != ESP_OK) return;
    if (nvs_get_i32(h, NVS_KEY, &v) == ESP_OK) sSelected = (int)v;
    nvs_close(h);
    if (sSelected >= spectrum_tape_count_n) sSelected = -1;
}

int spectrum_tape_count(void) { return spectrum_tape_count_n; }

const char *spectrum_tape_name(int i) {
    if (i < 0 || i >= spectrum_tape_count_n) return "Spectrum BASIC";
    return spectrum_tape_catalogue[i].name;
}

int spectrum_tape_selected(void) {
    if (sSelected == -2) loadSelection();
    return sSelected;
}

void spectrum_tape_select(int i) {
    nvs_handle_t h;
    if (i < -1 || i >= spectrum_tape_count_n) return;
    sSelected = i;
    if (nvs_open(NVS_NAMESPACE, NVS_READWRITE, &h) != ESP_OK) return;
    nvs_set_i32(h, NVS_KEY, (int32_t)i);
    nvs_commit(h);
    nvs_close(h);
}

const unsigned char *spectrum_tape_image(void) {
    int i = spectrum_tape_selected();
    return (i >= 0 && i < spectrum_tape_count_n) ? spectrum_tape_catalogue[i].tap : 0;
}

int spectrum_tape_size(void) {
    int i = spectrum_tape_selected();
    return (i >= 0 && i < spectrum_tape_count_n) ? spectrum_tape_catalogue[i].size : 0;
}

#endif /* RETRO_BOARD_ANDROID */
