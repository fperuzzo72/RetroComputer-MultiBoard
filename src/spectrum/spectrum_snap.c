/* spectrum_snap.c - which snapshot, out of the ones built into the firmware.
 *
 * The Spectrum's equivalent of the MSX's cartridge catalogue, and for the
 * same reason: with the images in flash the board needs no card to start
 * a game. A .sna is 27 bytes of registers followed by the whole 48kB of
 * RAM, so unlike a cartridge it has to be copied in - but it is copied
 * into the RAM the machine already owns, not allocated on top of it.
 *
 * Generated by tools/embed_snaps.py into spectrum_snap_data.c, which is
 * gitignored. No snapshots are distributed with this project.
 */
#include <stdio.h>

#include "nvs_flash.h"
#include "nvs.h"
#include "spectrum.h"

#ifdef RETRO_BOARD_ANDROID
/* On Android the snapshots are the .sna files in the card's spectrum/
 * folder (card_catalogue.h), read when one is started; the tapes beside
 * them are spectrum_tapes.c's. Only a 48K .sna is taken. */
#include "card_catalogue.h"

static const char *const snap_exts[] = {".sna", NULL};
static card_catalogue snaps = CARD_CATALOGUE("spectrum", snap_exts, "specsnapname");

int spectrum_snapshot_count(void) { return card_count(&snaps); }

const char *spectrum_snapshot_name(int i) {
    if (i < 0 || i >= card_count(&snaps)) return "Spectrum BASIC";
    return card_name(&snaps, i);
}

int spectrum_snapshot_selected(void) { return card_selected(&snaps); }
void spectrum_snapshot_select(int i) { card_select(&snaps, i); }

const unsigned char *spectrum_snapshot_image(void) {
    int size;
    const unsigned char *b = card_bytes(&snaps, &size);
    if (b && size != SNA_SIZE) {
        printf("spectrum: %s is %d bytes, not a 48K .sna\n", card_path(&snaps), size);
        return 0;
    }
    return b;
}

#else

#ifdef HAVE_SPECTRUM_SNAPS
extern const struct { const char *name; const unsigned char *sna; int size; }
    spectrum_snap_catalogue[];
extern const int spectrum_snap_count;
#else
static const struct { const char *name; const unsigned char *sna; int size; }
    spectrum_snap_catalogue[1];
static const int spectrum_snap_count = 0;
#endif

#define NVS_NAMESPACE "cyd"
#define NVS_KEY       "specsnap"

static int sSelected = -2;   /* -2 = unread, -1 = none (plain BASIC) */

static void loadSelection(void) {
    nvs_handle_t h;
    int32_t v = -1;
    sSelected = -1;
    if (nvs_open(NVS_NAMESPACE, NVS_READONLY, &h) != ESP_OK) return;
    if (nvs_get_i32(h, NVS_KEY, &v) == ESP_OK) sSelected = (int)v;
    nvs_close(h);
    if (sSelected >= spectrum_snap_count) sSelected = -1;
}

int spectrum_snapshot_count(void) { return spectrum_snap_count; }

const char *spectrum_snapshot_name(int i) {
    if (i < 0 || i >= spectrum_snap_count) return "Spectrum BASIC";
    return spectrum_snap_catalogue[i].name;
}

int spectrum_snapshot_selected(void) {
    if (sSelected == -2) loadSelection();
    return sSelected;
}

void spectrum_snapshot_select(int i) {
    nvs_handle_t h;
    if (i < -1 || i >= spectrum_snap_count) return;
    sSelected = i;
    if (nvs_open(NVS_NAMESPACE, NVS_READWRITE, &h) != ESP_OK) return;
    nvs_set_i32(h, NVS_KEY, (int32_t)i);
    nvs_commit(h);
    nvs_close(h);
}

const unsigned char *spectrum_snapshot_image(void) {
    int i = spectrum_snapshot_selected();
    return (i >= 0 && i < spectrum_snap_count) ? spectrum_snap_catalogue[i].sna : 0;
}

#endif /* RETRO_BOARD_ANDROID */
