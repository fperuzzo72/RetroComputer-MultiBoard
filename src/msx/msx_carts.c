/* msx_carts.c - which cartridge, out of the ones built into the firmware.
 *
 * The images live in flash (src/msx/local_cart_data.c, generated by
 * tools/embed_roms.py and gitignored) and are executed from there: a
 * 32kB image does not fit in RAM next to 64kB of emulated machine, and a
 * 128kB MegaROM certainly does not. Running them in place is the only way
 * a cartridge works on this board at all, and it is also what makes the
 * SD card unnecessary.
 *
 * The choice is remembered in NVS, so the board comes back up in whatever
 * it was last told to be.
 */
#include <stdio.h>
#include <string.h>

#include "nvs_flash.h"
#include "nvs.h"
#include "msx_carts.h"

#ifdef RETRO_BOARD_ANDROID
/* On Android the cartridges are the card's msx/ folder, not the flash:
 * there the card is a folder that is always there (card_catalogue.h).
 * fMSX loads the chosen file by its path (msx_cart_path, msx_bridge.c),
 * with its own loader, which mirrors and guesses mappers as it does for
 * any file; the built-in catalogue's power-of-two rule does not apply. */
#include "card_catalogue.h"

static const char *const cart_exts[] = {".rom", ".mx1", ".ri", NULL};
static card_catalogue carts = CARD_CATALOGUE("msx", cart_exts, "msxcartname");

int msx_cart_count_get(void) { return card_count(&carts); }

const char *msx_cart_name(int i) {
    if (i < 0 || i >= card_count(&carts)) return "MSX-BASIC (no cartridge)";
    return card_name(&carts, i);
}

int msx_cart_selected(void) { return card_selected(&carts); }
void msx_cart_select(int i) { card_select(&carts, i); }
const char *msx_cart_path(void) { return card_path(&carts); }
const unsigned char *msx_cart_image(void) { return 0; }
int msx_cart_size(void) { return 0; }

void msx_cart_list(void) {
    int i, sel = msx_cart_selected();
    printf("cartridges in the card's msx/ folder:\n");
    printf(" %c -1  %s\n", sel < 0 ? '*' : ' ', msx_cart_name(-1));
    for (i = 0; i < card_count(&carts); i++)
        printf(" %c %2d  %s\n", sel == i ? '*' : ' ', i, msx_cart_name(i));
}

#else

#ifdef HAVE_LOCAL_CART
extern const struct { const char *name; const unsigned char *rom; int size; }
    msx_cart_catalogue[];
extern const int msx_cart_count;
#else
static const struct { const char *name; const unsigned char *rom; int size; }
    msx_cart_catalogue[1];
static const int msx_cart_count = 0;
#endif

#define NVS_NAMESPACE "cyd"
#define NVS_KEY       "msxcart"

static int sSelected = -2;   /* -2 = not read yet, -1 = none (BASIC) */

static void loadSelection(void) {
    nvs_handle_t h;
    int32_t v = -1;
    sSelected = -1;
    if (nvs_open(NVS_NAMESPACE, NVS_READONLY, &h) != ESP_OK) return;
    if (nvs_get_i32(h, NVS_KEY, &v) == ESP_OK) sSelected = (int)v;
    nvs_close(h);
    if (sSelected >= msx_cart_count) sSelected = -1;
}

int msx_cart_count_get(void) { return msx_cart_count; }

const char *msx_cart_name(int i) {
    if (i < 0 || i >= msx_cart_count) return "MSX-BASIC (no cartridge)";
    return msx_cart_catalogue[i].name;
}

int msx_cart_selected(void) {
    if (sSelected == -2) loadSelection();
    return sSelected;
}

void msx_cart_select(int i) {
    nvs_handle_t h;
    if (i < -1 || i >= msx_cart_count) return;
    sSelected = i;
    if (nvs_open(NVS_NAMESPACE, NVS_READWRITE, &h) != ESP_OK) return;
    nvs_set_i32(h, NVS_KEY, (int32_t)i);
    nvs_commit(h);
    nvs_close(h);
}

/* Called from LoadCart() in the core, which takes "flash:cart" as a name
 * meaning "whatever is selected". */
const unsigned char *msx_cart_image(void) {
    int i = msx_cart_selected();
    return (i >= 0 && i < msx_cart_count) ? msx_cart_catalogue[i].rom : 0;
}

int msx_cart_size(void) {
    int i = msx_cart_selected();
    return (i >= 0 && i < msx_cart_count) ? msx_cart_catalogue[i].size : 0;
}

void msx_cart_list(void) {
    int i, sel = msx_cart_selected();
    printf("cartridges built into this firmware:\n");
    printf(" %c -1  %s\n", sel < 0 ? '*' : ' ', msx_cart_name(-1));
    for (i = 0; i < msx_cart_count; i++)
        printf(" %c %2d  %s (%dkB)\n", sel == i ? '*' : ' ', i,
               msx_cart_catalogue[i].name, msx_cart_catalogue[i].size / 1024);
    if (!msx_cart_count)
        printf("      (none - see tools/embed_roms.py)\n");
}

#endif /* RETRO_BOARD_ANDROID */
